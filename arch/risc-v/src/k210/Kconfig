## arch/risc-v/src/k210/Kconfig
```kconfig
#
# For a description of the syntax of this configuration file,
# see the file kconfig-language.txt in the NuttX tools repository.
#

comment "K210 Configuration Options"

config K210
	bool
	default y
	select K210_HAVE_UART1
	select K210_HAVE_TIMER1

menu "K210 Peripheral Support"

# These "hidden" settings determine is a peripheral option is available for the
# selection MCU

config K210_HAVE_UART1
	bool
	default n
	select UART1_SERIALDRIVER
	select ARCH_HAVE_SERIAL_TERMIOS

config K210_HAVE_TIMER1
	bool
	default n

config K210_HAVE_TIM2
	bool
	default n

config K210_HAVE_I2C1
	bool
	default n

config K210_HAVE_SPI1
	bool
	default n

# These are the peripheral selections proper

config K210_I2C1
	bool "I2C1"
	default n
	select K210_I2C

config K210_SPI1
	bool "SPI1"
	default n
	select SPI
	select K210_SPI

config K210_TIMER1
	bool "TIMER1"
	default n
	depends on K210_HAVE_TIMER1

config K210_TIMER2
	bool "TIMER2"
	default n

config K210_UART1
	bool "UART1"
	default n
	select ARCH_HAVE_UART1
	select ARCH_HAVE_SERIAL_TERMIOS
	select K210_UART

endmenu

config K210_SPI
	bool

config K210_I2C
	bool

config K210_UART
	bool

config K210_UART_RX_BUF_SIZE
	int "UART RX Bufer size"
	default 64
	depends on K210_UART
	---help---
		Size of RX buffers for K210 UARTs

config K210_UART_TX_BUF_SIZE
	int "UART TX Bufer size"
	default 64
	depends on K210_UART
	---help---
		Size of TX buffers for K210 UARTs
```

## arch/risc-v/src/rv64gc/Kconfig
```kconfig
#
# For a description of the syntax of this configuration file,
# see the file kconfig-language.txt in the NuttX tools repository.
#

comment "RV64GC Configuration Options"

choice
	prompt "Toolchain Selection"
	default RV64GC_TOOLCHAIN_GNU_RVGW if TOOLCHAIN_WINDOWS
	default RV64GC_TOOLCHAIN_GNU_RVGL if !TOOLCHAIN_WINDOWS

config RV64GC_TOOLCHAIN_GNU_RVGL
	bool "Generic GNU RVG toolchain under Linux (or other POSIX environment)"
	select ARCH_TOOLCHAIN_GNU
	---help---
		This option should work for any modern GNU toolchain (GCC 5.2 or newer)
		configured for riscv32-unknown-elf.

config RV64GC_TOOLCHAIN_GNU_RVGW
	bool "Generic GNU RVG toolchain under Windows"
	select ARCH_TOOLCHAIN_GNU
	depends on TOOLCHAIN_WINDOWS
	---help---
		This option should work for any modern GNU toolchain (GCC 5.2 or newer)
		configured for riscv32-unknown-elf.


endchoice

config RV64GC_HW_MULDIV
	bool "Supports Hardware MUL and DIV"
	default n
	---help---
		Specifies if the architecture supports hardware multiply and
		hardware division instructions.  Selecting this will cause the
		generated code to natively use mul / div instructions for any
		math operations.

config RV64GC_SYSTEM_CSRRS_SUPPORT
	bool "Supports RV core feature identification via CSRRS opcode"
	default n
	---help---
		Specifies if the architecture supports the SYSTEM opcode for reading
		Control Status Registers to obtain the RV core option flags.

config RV64GC_CUSTOM_IRQ_SUPPORT
	bool "Has custom implementation for IRQ handling"
	default n
	---help---
		Allows overriding the standard IRQ processing as described
		in the RISC-V architecture documents.  This allows architecture
		specific code to support non-standard IRQ processing in the core.
```
